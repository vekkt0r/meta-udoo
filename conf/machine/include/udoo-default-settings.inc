## conf/machine/udooneo.conf
```bitbake
#@TYPE: Machine
#@NAME: UDOO Neo i.MX6 SoloX
#@SOC: i.MX6S
#@DESCRIPTION: Machine configuration for i.MX6 UDOO Neo SoloX
#@MAINTAINER: Christian Ege <ch@ege.io>

MACHINEOVERRIDES =. "mx6:mx6sx:"

include conf/machine/include/imx-base.inc
include conf/machine/include/tune-cortexa9.inc
include conf/machine/include/udoo-imx-base.inc

PREFERRED_PROVIDER_virtual/kernel ?= "linux-fslc"
KERNEL_IMAGETYPE = "zImage"

KERNEL_DEVICETREE ?= " \
    imx6sx-udoo-neo-basic.dtb \
    imx6sx-udoo-neo-extended.dtb \
    imx6sx-udoo-neo-full.dtb \
"

UBOOT_CONFIG[sd] = "udoo_neo_config,sdcard"

MACHINE_FEATURES += " usbhost usbgadget bluetooth wifi"
MACHINE_EXTRA_RRECOMMENDS += " kernel-modules wl18xx-conf uim-sysfs bt-firmware udoofota"

SERIAL_CONSOLES ?= "115200;ttymxc0 115200;ttyGS0"
KERNEL_MODULE_AUTOLOAD += " g_serial"


# Select the video output mode
# Possible values are
# - hdmi (default)
# - lvds7
# - lvds15
VIDEO_OUTPUT ?= "hdmi"

# Select if the CAN-Bus shall be activated or not
ENABLE_CAN_BUS ?= "0"

# Select if the SPI bus on ESPI_2 shall be activated or not
ENABLE_SPI_BUS ?= "0"

# There is no more boot partition so install the needed files to /boot
MACHINE_ESSENTIAL_EXTRA_RDEPENDS += " udoo-u-boot-scr \
"
```
